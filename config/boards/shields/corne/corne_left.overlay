#include "corne.dtsi"

&kscan0 {
    /* I TUOI PIN DELLE COLONNE - SINISTRA */
    col-gpios
        = <&pro_micro 21 GPIO_ACTIVE_HIGH>
        , <&pro_micro 8 GPIO_ACTIVE_HIGH>
        , <&pro_micro 19  GPIO_ACTIVE_HIGH>
        , <&pro_micro 9  GPIO_ACTIVE_HIGH>
        , <&pro_micro 4  GPIO_ACTIVE_HIGH>
        , <&pro_micro 6  8GPIO_ACTIVE_HIGH>
        ;
};
