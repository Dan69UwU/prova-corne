/* config/corne_left.overlay */
#include <dt-bindings/zmk/matrix_transform.h>

/* Diciamo a ZMK di usare i TUOI pin per la matrice */
&kscan0 {
    col-gpios
        = <&pro_micro 10 GPIO_ACTIVE_HIGH>
        , <&pro_micro 14 GPIO_ACTIVE_HIGH>
        , <&pro_micro 5  GPIO_ACTIVE_HIGH>
        , <&pro_micro 3  GPIO_ACTIVE_HIGH>
        , <&pro_micro 7  GPIO_ACTIVE_HIGH>
        , <&pro_micro 9  GPIO_ACTIVE_HIGH>
        ;
    /* Se hai cambiato anche le righe (row-gpios), modificale qui sotto */
};
